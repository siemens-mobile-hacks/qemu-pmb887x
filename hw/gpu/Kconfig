## hw/gpu/Kconfig
```kconfig
config S1D13705
    bool
    depends on SSI

config S1D13716
    bool
    depends on SSI

config S1D13732
    bool
    depends on SSI
```

## hw/gsm/Kconfig
```kconfig
config GSM_IQ_BUS
    bool

config GSM_NETWORK
    bool

config GSM_AIR
    bool
    select GSM_IQ_BUS
    select GSM_NETWORK

config GSM_KASUMI
    bool

config GSM_GEA
    bool

config GSM_CODING
    bool

config GSM_BTS
    bool
    select GSM_AIR
    select GSM_CODING
    select GSM_NETWORK

config GSM_OSMOTRX
    bool
    select GSM_AIR
    select GSM_CODING
    select GSM_NETWORK

config HD15515X
    bool
    select GSM_AIR

config PMB627X
    bool
    select GSM_AIR
```

## hw/lcd/Kconfig
```kconfig
config LCD
    bool
    depends on SSI

config JBT6K71
    bool
    select LCD

config SSD1286
    bool
    select LCD

config PCF8882
    bool
    select LCD

config LH15KAH2
    bool
    select LCD

config L2F50333T
    bool
    select LCD

config L2F50126T
    bool
    select LCD

config L2F50250
    bool
    select LCD

config LR38826
    bool
    select LCD

config R61505
    bool
    select LCD

config R63400
    bool
    select LCD
```

## hw/pmic/Kconfig
```kconfig
config D1094XX
    bool
    depends on I2C
    select AUDIO_ROUTER

config PMB6812
    bool
    depends on I2C
    select AUDIO_ROUTER
```
